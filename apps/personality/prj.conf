## CMakeLists.txt
```
# CMakeLists.txt

cmake_minimum_required(VERSION 3.20.0)

# Tell CMake/Zephyr we’ll use C and C++
find_package(Zephyr REQUIRED HINTS $ENV{ZEPHYR_BASE})
project(personality_app LANGUAGES C CXX)

# C++ standard & flags (tweak as you like)
set(CMAKE_CXX_STANDARD 17)
set(CMAKE_CXX_STANDARD_REQUIRED ON)
set(CMAKE_CXX_EXTENSIONS OFF)

# Typical embedded knobs; enable if you want exceptions/RTTI later
add_compile_options(
		$<$<COMPILE_LANGUAGE:CXX>:
		-fno-exceptions
		-fno-rtti
		-fno-threadsafe-statics
		>
)

# Your sources (C++ main + modules)
target_sources(app PRIVATE
		src/main.cpp
		src/sched.cpp
		src/cli_shell.cpp
		# add more .cpp files as created
)
```

## prj.conf
```kconfig
#prj.conf

# Core logging/console
CONFIG_SERIAL=y
CONFIG_CONSOLE=y
CONFIG_LOG=y
CONFIG_LOG_DEFAULT_LEVEL=3

# C++ runtime / libstdc++
CONFIG_CPP=y
CONFIG_LIB_CPLUSPLUS=y
CONFIG_NEWLIB_LIBC=y

# Optional Zephyr shell
# CONFIG_SHELL=y
# CONFIG_UART_CONSOLE=y

# If you decide to use exceptions/RTTI later, enable these AND
# remove the -fno-exceptions / -fno-rtti flags above:
# CONFIG_CPP_EXCEPTIONS=y
# CONFIG_CPP_RTTI=y
```

## src/main.cpp
```c
#include "app_core.hpp"

#if defined(PLATFORM_AMBIQ)
  #include "ambiq/ambiq_platform.hpp"
  using PlatformT = AmbiqPlatform;
#else
#include "host/host_platform.hpp"
using PlatformT = HostPlatform;
#endif

int main() {
	PlatformT plat;
	run_app(plat);   // template; inlines on MCU
}
```

## src/app_core.hpp
```c
#pragma once
#include <cstdint>

// simple sensor sample struct #TODO: Fully implement with proper sensor setup
struct Sample {
	uint8_t data[8];
};

// Template entrypoint, inlined for zero overhead on MCU
template <class Platform>
[[noreturn]] void run_app(Platform& plat) {
	plat.init_low_power();
	plat.log("Personality app starting...");

	while (true) {
		if (plat.sensor_ready()) {
			Sample s = plat.read_sample();
			plat.process(s);
		}
		plat.sleep_until_event(); // DEEPSLEEP + interrupt
	}
}
```

## src/cli_shell.cpp
```c
// cli_shell.cpp
// optional: wire Zephyr shell commands later (still fine as C++)
```

## src/main_host.cpp
```c
#include "platform.hpp"
#include <memory>
#include <array>
#include <cstdint>
#include <string>

std::unique_ptr<Platform> make_host_platform(); // from host impl

int main() {
	auto plat = make_host_platform();
	plat->log("Host app start");

	// demo: poll fake sensor 0x68, reg 0x10, 6 bytes, blink LED
	std::array<uint8_t, 6> buf{};
	for (int i = 0; i < 10; ++i) {
		plat->led_toggle();
		plat->delay_ms(200);
		plat->i2c_read(0x68, 0x10, buf.data(), buf.size());
		plat->log("Sensor bytes: " + std::to_string(buf[0]) + "," +
				  std::to_string(buf[1]) + "," + std::to_string(buf[2]) + "...");
	}

	plat->log("Done.");
	return 0;
}
```

## src/sched.cpp
```c
// sched.cpp

extern "C" {
#include <zephyr/kernel.h>
}
void personality_sched_tick() {
	// placeholder for scheduler; call from main if preferred
}
```
